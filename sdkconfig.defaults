## sdkconfig.defaults
```kconfig
# Power Management - Enable automatic power saving
CONFIG_PM_ENABLE=y
CONFIG_PM_DFS_INIT_AUTO=y
CONFIG_PM_USE_RTC_TIMER_REF=y
CONFIG_PM_PROFILING=n
CONFIG_PM_TRACE=n

# CPU Frequency - Lower to 80MHz to save power
CONFIG_ESP_DEFAULT_CPU_FREQ_MHZ_80=y
CONFIG_ESP_DEFAULT_CPU_FREQ_MHZ=80

# Flash Power Down in Deep Sleep
CONFIG_ESP_SLEEP_POWER_DOWN_FLASH=y

# WiFi Power Saving
CONFIG_ESP_WIFI_SLP_IRAM_OPT=y
CONFIG_ESP_WIFI_SLP_DEFAULT_MIN_ACTIVE_TIME=100
CONFIG_ESP_WIFI_SLP_DEFAULT_MAX_ACTIVE_TIME=5
CONFIG_ESP_WIFI_STA_DISCONNECTED_PM_ENABLE=y

# Light Sleep Options
CONFIG_ESP_SLEEP_FLASH_LEAKAGE_WORKAROUND=y
CONFIG_ESP_SLEEP_GPIO_RESET_WORKAROUND=y
CONFIG_ESP_SLEEP_MSPI_NEED_ALL_IO_PU=n

# Minimize Logging
CONFIG_LOG_DEFAULT_LEVEL_ERROR=y
CONFIG_LOG_DEFAULT_LEVEL=1
CONFIG_LOG_MAXIMUM_LEVEL=1

# Compiler Optimization for Size
CONFIG_COMPILER_OPTIMIZATION_SIZE=y
CONFIG_COMPILER_OPTIMIZATION_ASSERTIONS_SILENT=y
```
